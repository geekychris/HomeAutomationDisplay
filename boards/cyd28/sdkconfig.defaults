## main/Kconfig.projbuild
```kconfig
menu "Home Automation Display"

config HAD_HOSTNAME
    string "Network name (mDNS and DHCP)"
    default "home-display"
    help
        The device answers at http://<name>.local/ and shows up under this
        name in the router's device list (with the end of the MAC added, see
        below).

config HAD_HOSTNAME_ADD_MAC
    bool "Add the end of the MAC to the network name"
    default y
    help
        "home-display-a1b2c3" rather than "home-display", so several displays
        on one network each have their own name.

config HAD_HUB_URL
    string "Hub address (blank: find it with mDNS)"
    default ""
    help
        The hub's WebSocket, for example "ws://192.168.1.20:8390/ws". Leave
        blank and the display looks for a hub advertising _hadisplay._tcp.
        An address saved from the web page (http://<name>.local/hub)
        overrides this.

config HAD_AP_SSID
    string "Setup access point SSID"
    default "home-display-setup"
    help
        An open network that comes up when no WiFi is saved, or none of the
        saved networks can be joined, so the device can always be set up.

config HAD_WIFI_MAX_RETRY
    int "STA failures before the setup AP comes up"
    default 8

config HAD_NTP_SERVER
    string "NTP server"
    default "pool.ntp.org"

config HAD_TZ
    string "Time zone (POSIX TZ string)"
    default "PST8PDT,M3.2.0,M11.1.0"
    help
        For example "GMT0BST,M3.5.0/1,M10.5.0" for the UK or
        "CET-1CEST,M3.5.0,M10.5.0/3" for central Europe.

choice HAD_BOARD
    prompt "Board"
    default HAD_BOARD_CROWPANEL_P4_9 if IDF_TARGET_ESP32P4
    default HAD_BOARD_CYD28
    help
        Which display board this is built for: its panel, touch controller
        and wiring (components/board/boards.c). Each board also has its own
        sdkconfig defaults under boards/, which pick this for you.

    config HAD_BOARD_CYD28
        bool "2.8\" Cheap Yellow Display (ESP32-2432S028R, ELEGOO E32R28T)"
        depends on IDF_TARGET_ESP32
    config HAD_BOARD_ST7796R
        bool "3.5\"/4.0\" ST7796, resistive touch (Sunton ESP32-3248S035R, ELEGOO E32R35T, E32R40T)"
        depends on IDF_TARGET_ESP32
        help
            These boards are wired the same: ST7796 480x320 on SPI2, XPT2046
            touch on the same bus. (ELEGOO's E32N35T and E32N40T are the same
            boards without touch, which this firmware needs.)
    config HAD_BOARD_SUNTON35C
        bool "3.5\" Sunton ESP32-3248S035C (capacitive touch, GT911)"
        depends on IDF_TARGET_ESP32
    config HAD_BOARD_CROWPANEL_P4_9
        bool "9\" Elecrow CrowPanel Advanced ESP32-P4 (1024x600)"
        depends on IDF_TARGET_ESP32P4
endchoice

config HAD_LCD_INVERT
    bool "Invert the panel's colours (from the board's default)"
    default n
    help
        Turn on if colours come out as a negative. Batches of the same board
        sometimes differ.

config HAD_LCD_MIRROR_X
    bool "Mirror the picture left to right (from the board's default)"
    default n
    help
        Turn on if text comes out backwards.

endmenu
```
